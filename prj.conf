## CMakeLists.txt
```
cmake_minimum_required(VERSION 3.20.0)

find_package(Zephyr REQUIRED HINTS $ENV{ZEPHYR_BASE})
project(my_zephyr_app)

set(APP_SRC src/at/test.c
            src/at/ver.c
            src/at/id.c
            src/at/fdefault.c
            src/at/reset.c
            src/at/low_power.c
            src/at/msg.c
            src/at/msg_hex.c
            src/at/c_msg.c
            src/at/c_msg_hex.c
            src/at/p_msg.c
            src/at/p_msg_hex.c
            src/at/ch.c
            src/at/dr.c
            src/at/adr.c
            src/at/rept.c
            src/at/retry.c
            src/at/power.c
            src/at/port.c
            src/at/mode.c
            src/device/devices.c
            src/events/device_callbacks.c
            src/file/flash_data.c
            src/iface/at_command.c
            src/init/dev_init.c
            src/init/env_init.c
            src/init/thread_init.c
            src/telemetry/lorawan_io.c
            src/telemetry/uart_io.c
            src/util/arg_parse.c
            src/util/custom_typedefs.c
            src/workers/at_command.c
            src/workers/event.c
            src/workers/lorawan.c
            src/app.c
            src/main.c
)

target_sources(app PRIVATE ${APP_SRC})
```

## prj.conf
```kconfig
# CONFIG_BOOT_BANNER=n

# CONFIG_NO_OPTIMIZATIONS=y

CONFIG_REBOOT=y

CONFIG_SPI=y
CONFIG_LORA=y
CONFIG_LORA_SX12XX=y

CONFIG_LORAWAN=y
CONFIG_LORAMAC_REGION_KR920=y

CONFIG_MAIN_STACK_SIZE=4096
CONFIG_SYSTEM_WORKQUEUE_STACK_SIZE=4096

CONFIG_HEAP_MEM_POOL_SIZE=4096

CONFIG_PRINTK=n
CONFIG_SERIAL=y
CONFIG_UART_INTERRUPT_DRIVEN=y

CONFIG_MINIMAL_LIBC=y
CONFIG_MINIMAL_LIBC_MALLOC=y
CONFIG_MINIMAL_LIBC_CALLOC=y
CONFIG_MINIMAL_LIBC_LL_PRINTF=y
CONFIG_MINIMAL_LIBC_REALLOCARRAY=y

CONFIG_FLASH=y
CONFIG_FLASH_MAP=y
CONFIG_FLASH_PAGE_LAYOUT=y

CONFIG_I2C=y
CONFIG_SPI=y

CONFIG_POSIX_API=y
```

## src/main.c
```c
#include "./app.h"

struct app_data app_data = { 0 };

/**
 * @author Jin
 * @brief App entrance
 * 
 */
void main(void)
{
    // while (1)
    // {
    //     k_sleep(K_MSEC(100));
    // }

    app_init(&app_data);
    app_start(&app_data);
}
```

## src/app.c
```c
#include "./app.h"
#include "./device/devices.h"
#include "./init/dev_init.h"
#include "./init/thread_init.h"

#include <zephyr.h>

K_THREAD_STACK_DEFINE(fuck, 1024);

/**
 * @brief initialize this app
 * 
 * @param app_data 
 */
void app_init(struct app_data* app_data)
{
    get_devices(app_data);
    dev_init(app_data->devs);
    // todo env_init
    threads_init(app_data);
    app_data->app_alive = true;
}

/**
 * @author Jin
 * @brief 
 * 
 */
void app_start(const struct app_data* app_data)
{
    threads_start(app_data);
}

/**
 * @author Jin
 * @brief 
 * 
 */
void app_deinit(const struct app_data* app_data)
{
    threads_destoy(app_data);
}

/**
 * @brief is this app still alive?
 * 
 * @param app_data 
 * @return true alive
 * @return false dead
 */
bool is_app_alive(const struct app_data* app_data)
{
    return app_data->app_alive;
}
```

## src/app.h
```c
#ifndef __APP_H__
#define __APP_H__

#ifdef __cplusplus
extern "C"
{
#endif 

#include <stddef.h>
#include <stdbool.h>

#include <zephyr.h>

struct devices;
struct lorawan_join_config;

#ifndef NUM_APP_THREADS
#define NUM_APP_THREADS 3
#endif

#ifndef APP_THREAD_STACK_SIZE
#define APP_THREAD_STACK_SIZE 2048
#endif 


struct app_data
{
    struct devices*                devs;
    struct k_thread                app_threads[NUM_APP_THREADS];
    struct z_thread_stack_element app_thread_stacks[NUM_APP_THREADS][APP_THREAD_STACK_SIZE + 32];
    size_t                         num_app_threads;

    struct lorawan_join_config*    lorawan_cfg;
    struct k_mutex                 uart_output_mtx;

    bool                           app_alive;
};

void app_init(struct app_data*);
void app_start(const struct app_data*);
void app_deinit(const struct app_data*);

bool is_app_alive(const struct app_data*);

#ifdef __cplusplus
}
#endif

#endif
```
